## layers/meta-pointone-atlas/conf/layer.conf
```bitbake
LAYERSERIES_COMPAT_meta-pointone-atlas="sumo thud warrior zeus"

# We have a conf and classes directory, add to BBPATH
BBPATH .= ":${LAYERDIR}"

# We have recipes-* directories, add to BBFILES
BBFILES += "${LAYERDIR}/recipes-*/*/*.bb \
            ${LAYERDIR}/recipes-*/*/*.bbappend"

BBFILE_COLLECTIONS += "meta-pointone-atlas"
BBFILE_PATTERN_meta-pointone-atlas = "^${LAYERDIR}/"
BBFILE_PRIORITY_meta-pointone-atlas = "6"

# Add libatomic and libstdc++ to the rootfs. They are not installed in the
# Balena image by default.
IMAGE_INSTALL_append = " libatomic libstdc++"

# Enable tmux.
IMAGE_INSTALL_append = " tmux"
```
